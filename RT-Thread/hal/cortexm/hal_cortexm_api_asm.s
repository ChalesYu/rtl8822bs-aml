;****************************************Copyright (c)***************************************************
;**                             成 都 世 纪 华 宁 科 技 有 限 公 司
;**                                http://www.huaning-iot.com
;**                                http://hichard.taobao.com
;**
;**
;**--------------File Info--------------------------------------------------------------------------------
;** File name:          hal_cortexm_api_asm.asm
;** Last modified Date: 2019-03-15
;** Last Version:       v1.00
;** Descriptions:       Cortex-M内核的api接口实现，主要用汇编语言实现
;**-------------------------------------------------------------------------------------------------------
;** Created By:         Renhaibo任海波
;** Created date:       2019-03-15
;** Version:            v1.00
;** Descriptions:       The original version
;**
;**-------------------------------------------------------------------------------------------------------
;** Modified by:        
;** Modified date:      
;** Version:            
;** Description:        
;**
;*********************************************************************************************************

;*********************************************************************************************************
;  Declarations for the exported functions
;  输出外部声明
;*********************************************************************************************************
	PUBLIC   hal_enter_critical
	PUBLIC   hal_exit_critical
        PUBLIC   hal_enter_sleep
	PUBLIC   __hal_app_jump

;*********************************************************************************************************
;  Registers or macros used by this file
;  本文件用到的寄存器和宏
;*********************************************************************************************************

	RSEG CODE:CODE:NOROOT(2)

;*********************************************************************************************************
;** Function name:      hal_enter_critical
;** Descriptions:       关中断，进入临界区，
;** Input parameters:   R0：指定关闭的中断起始优先级
;** Output parameters:  None 无
;** Returned value:     关闭中断前的中断标志状态
;** Created by:         Renhaibo任海波
;** Created Date:       2011-04-16
;**-------------------------------------------------------------------------------------------------------
;** Modified by:
;** Modified date:
;**-------------------------------------------------------------------------------------------------------
;*********************************************************************************************************
hal_enter_critical
        PUSH    {R1,R2} 
        MRS     R1, PRIMASK
        MOV     R2, #0x01
        TST     R0, #0xFF                       ; 参数R0中的数据是否为0
        ITE     EQ                              ; 如果为0,则关闭优先级0以及0以上优先级的所有中断
        MSREQ   PRIMASK, R2
        MSRNE   BASEPRI, R0                     ; 反之，如果不为0，则关闭参数指定的优先级以上的中断
        MOV     R0, R1
        POP     {R1,R2}
        BX      LR


;*********************************************************************************************************
;** Function name:      hal_exit_critical
;** Descriptions:       退出临界区，并恢复保护临界区前的中断标志状态
;** Output parameters:  None 无
;** Input parameters:   R0： 临界区保护之前的中断状态
;** Returned value:     None 无
;** Created by:         Renhaibo任海波
;** Created Date:       2011-04-16
;**-------------------------------------------------------------------------------------------------------
;** Modified by:        
;** Modified date:      
;**-------------------------------------------------------------------------------------------------------
;*********************************************************************************************************
hal_exit_critical
        MSR     PRIMASK, R0
        MOV     R0, #0x00
        MSR     BASEPRI, R0
        BX      LR

;*********************************************************************************************************
;** Function name:      hal_enter_sleep
;** Descriptions:       控制进入睡眠模式
;** Output parameters:  NONE 无
;** Input parameters:   NONE 无
;** Returned value:     NONE 无
;*********************************************************************************************************
hal_enter_sleep
        WFI
        BX      LR
        
;*********************************************************************************************************
;** Function name:      hal_app_jump
;** Descriptions:       应用程序跳转，跳转到指定地址的应用程序
;** Input parameters:   R0：新的应用程序地址
;** Output parameters:  NONE
;** Returned value:     NONE
;** Created by:         Renhaibo任海波
;** Created Date:       2011-04-16
;**-------------------------------------------------------------------------------------------------------
;** Modified by:
;** Modified date:
;**-------------------------------------------------------------------------------------------------------
;*********************************************************************************************************
__hal_app_jump
    CPSID   I                       ;  关闭中断

    LDR     R1, =0xE000ED08         ;  切换向量表到应用程序的起始地址
    STR     R0, [R1]

    MOV     R2, #0x00               ;  切换工作模式，工作到特权级的线程模式  使用MSP
    MSR     CONTROL, R2

    LDR     R1, [R0]                ;  设置堆栈指针
    MOV     SP, R1

    CPSIE   I                       ;  使能中断
    LDR	    R0, [R0, #4]	    ;  设置当前PC的值，开始运行新的应用程序
    BX      R0
    
	END
;*********************************************************************************************************
;  __END FILE 
;*********************************************************************************************************
